/**
 ******************************************************************************
 * @file           : main.c
 * @author         : Daphne Felt, Shruti Kalyankar
 * @brief          : System Clock Config, helper delay, main loop
 * @Acknowldgement : SystemClock_Config function is as generated by STMCubeIDE
 ******************************************************************************
*/

#include <stdbool.h>
#include <stdio.h>
#include "stm32f411xe.h"
#include "main.h"
#include "led.h"
#include "spi.h"
#include "lcd.h"
#include "joystick.h"
#include "uart.h"
#include "pages.h"
#include "accelerometer.h"
#include "workout_inference.h"
#include "heartrate.h"
#include "pedometer.h"
#include "i2c.h"

void delay(volatile uint32_t t) {
    while(t--);
}

void SystemClock_Config(void) {
    RCC_OscInitTypeDef RCC_OscInitStruct = {0};
    RCC_ClkInitTypeDef RCC_ClkInitStruct = {0};

    __HAL_RCC_PWR_CLK_ENABLE();
    __HAL_PWR_VOLTAGESCALING_CONFIG(PWR_REGULATOR_VOLTAGE_SCALE1);

    RCC_OscInitStruct.OscillatorType = RCC_OSCILLATORTYPE_HSI;
    RCC_OscInitStruct.HSIState = RCC_HSI_ON;
    RCC_OscInitStruct.HSICalibrationValue = RCC_HSICALIBRATION_DEFAULT;
    RCC_OscInitStruct.PLL.PLLState = RCC_PLL_ON;
    RCC_OscInitStruct.PLL.PLLSource = RCC_PLLSOURCE_HSI;
    RCC_OscInitStruct.PLL.PLLM = 8;
    RCC_OscInitStruct.PLL.PLLN = 192;
    RCC_OscInitStruct.PLL.PLLP = RCC_PLLP_DIV4;
    RCC_OscInitStruct.PLL.PLLQ = 8;
    HAL_RCC_OscConfig(&RCC_OscInitStruct);

    RCC_ClkInitStruct.ClockType = RCC_CLOCKTYPE_HCLK|RCC_CLOCKTYPE_SYSCLK
                                |RCC_CLOCKTYPE_PCLK1|RCC_CLOCKTYPE_PCLK2;
    RCC_ClkInitStruct.SYSCLKSource = RCC_SYSCLKSOURCE_PLLCLK;
    RCC_ClkInitStruct.AHBCLKDivider = RCC_SYSCLK_DIV1;
    RCC_ClkInitStruct.APB1CLKDivider = RCC_HCLK_DIV4;
    RCC_ClkInitStruct.APB2CLKDivider = RCC_HCLK_DIV2;
    HAL_RCC_ClockConfig(&RCC_ClkInitStruct, FLASH_LATENCY_3);
}

void Error_Handler(void) {
    __disable_irq();
    while(1) {}
}

int main(void) {
	HAL_Init();					//since we have used HAL for i2c and spi initialization
    SystemClock_Config();

    /*The LED part of the code was only done for debugging purposes*/
    /* Enable GPIOD clock (LEDs) */
	RCC->AHB1ENR |= RCC_AHB1ENR_GPIODEN;
	/* Configure PD12-PD15 as output */
	GPIOD->MODER |= (1<<(12*2)) | (1<<(13*2)) | (1<<(14*2)) | (1<<(15*2));

	 /* Initialize SPI and LCD */
	SPI1_Init();    // SPI1 must be initialized first
	LCD_Init();     // Then initialize LCD

	// init uart for texting
	UART_Init();
	char buff[120];
	// initialize i2c the accelerometer and heartrate sensor
	init_i2c();
	HAL_Delay(10);
	Accel_Init();

	/* Clear LCD screen and opening animation */
	LCD_Clear(COLOR_BLACK);
	OpeningScreen_Slide();

	/* Initialize Joystick ADC */
	Joystick_Init();
	uint16_t x, y;
	sendStringGreen("SEND TEXTS HERE:\n\r");  //prints on uart

	uint8_t text_num = 0;
	AccelRawData accelData;

    // set up AI workout detections
    if (!Workout_Init()) {
        sendString("ERROR: AI model initialization failed\r\n");
    }

    uint32_t accel_timer = 0;
    uint32_t task_timer = 0;
    uint32_t last_inference = 0;

    // heartrate sensor data
    MAX30102_Data hr_data;
    MAX30102_Init();

    //write initial values to data types which will be overwritten
    CalculateBMR();
    PedometerData pedometer_data = {0, 0, 0, 0};
    HealthStats stats = {0, 0, 0, 0.0f, 0.0f, 0.0f};
    uint32_t stat_update_timer = 0;

    /*starts main loop program*/
    while(1) {
        uint32_t now = HAL_GetTick();   //for the clock page

        /*Workout inferencing*/

        // Sample accelerometer every 10ms (100hz, same speed we trained the model with)
        if (now - accel_timer >= 10) {
            accel_timer = now;
            Accel_ReadRaw(&accelData);
            Workout_AddSample(accelData.x, accelData.y, accelData.z); // add to buffer

            // inference, max 1s at a time
            if (Workout_ShouldInfer() && (now - last_inference > 1000)) {

                WorkoutResult result;
                if (Workout_RunInference(&result)) {

                    Pages_UpdateWorkout(Workout_GetName(result.predicted_class));

                    last_inference = now;

                }
            }

            Pedometer_Update(&accelData);

            // also grab hr at same freq
            MAX30102_Update(&hr_data);
        }

        // do the rest less frequently every 100ms
        if (now - task_timer >= 100){
        	task_timer = now;

        	// INCOMING TEXTS HANDLING AND CONTROLLING DISPLAY PAGES THROUGH BLUETOOTH
			UART_ProcessInput();
			if (UART_TextReady()){
				text_num = text_num + 1;
				char * text = UART_GetLine();

				if (strcmp(text,"clock")==0){
					Pages_Display(PAGE_CLOCK);
				};
				if (strcmp(text,"stats")==0){
					Pages_Display(PAGE_STATS);
				};
				if (strcmp(text,"texts")==0){
					Pages_Display(PAGE_TEXTS);
				};
				if (strcmp(text,"workout")==0){
					Pages_Display(PAGE_WORKOUTS);
				};

				Pages_AddText(text);
			}

			/* Read joystick values */
			Joystick_Read(&x, &y);
			HandleJoystick(x,y);
        }

        //do this every seconds
        if (now - stat_update_timer >=1000){ // 1 s update
        	stat_update_timer = now;

        	Pedometer_GetStats(&pedometer_data);
			stats.calories = pedometer_data.calories;
			stats.distance = pedometer_data.distance;
			stats.steps = pedometer_data.steps;

			if (hr_data.valid){
				stats.heart_rate = hr_data.heart_rate;
				stats.oxygen_level = hr_data.spo2;
			} else {
				stats.heart_rate = 0;
				stats.oxygen_level = 0;
			}
			stats.temperature = hr_data.temperature;

			Pages_UpdateStats(&stats);
        }
    }
}
